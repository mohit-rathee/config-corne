## config/west.yml
```yaml
manifest:
  remotes:
    - name: zmk-fork
      url-base: https://github.com/mohit-rathee
  projects:
    - name: zmk-fork
      remote: zmk-fork
      revision: main
      import: app/west.yml
  self:
    path: config
```
